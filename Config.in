## Config.in
```kconfig
menu "Doom Packages"
    source "$BR2_EXTERNAL_wsap3825_doom_PATH/package/doom-startscript/Config.in"
endmenu
```

## configs/wsap3825_doom_defconfig
```kconfig
BR2_powerpc=y
BR2_powerpc_8548=y
BR2_KERNEL_HEADERS_6_1=y
BR2_TOOLCHAIN_BUILDROOT_WCHAR=y
BR2_TOOLCHAIN_BUILDROOT_CXX=y
BR2_ENABLE_LTO=y
BR2_PER_PACKAGE_DIRECTORIES=y
BR2_TARGET_GENERIC_ROOT_PASSWD="root"
BR2_ROOTFS_OVERLAY="$(BR2_EXTERNAL_wsap3825_doom_PATH)/board/wsap3825i/rootfs_overlay"
BR2_ROOTFS_POST_BUILD_SCRIPT="$(BR2_EXTERNAL_wsap3825_doom_PATH)/board/wsap3825i/post-build.sh"
BR2_ROOTFS_POST_IMAGE_SCRIPT="$(BR2_EXTERNAL_wsap3825_doom_PATH)/board/wsap3825i/mkimage.sh"
BR2_LINUX_KERNEL=y
BR2_LINUX_KERNEL_PATCH="$(BR2_EXTERNAL_wsap3825_doom_PATH)/board/wsap3825i/linux.patch"
BR2_LINUX_KERNEL_USE_CUSTOM_CONFIG=y
BR2_LINUX_KERNEL_CUSTOM_CONFIG_FILE="$(BR2_EXTERNAL_wsap3825_doom_PATH)/board/wsap3825i/linux.config"
BR2_LINUX_KERNEL_IMAGE_TARGET_CUSTOM=y
BR2_LINUX_KERNEL_IMAGE_TARGET_NAME="simpleImage.ws-ap3825i"
BR2_LINUX_KERNEL_IMAGE_NAME="simpleImage.ws-ap3825i"
BR2_PACKAGE_ASCII_INVADERS=y
BR2_PACKAGE_CHOCOLATE_DOOM=y
BR2_PACKAGE_DOOM_WAD=y
BR2_PACKAGE_DIRECTFB=y
BR2_PACKAGE_SDL2_DIRECTFB=y
BR2_PACKAGE_LINUX_FIRMWARE=y
BR2_PACKAGE_LINUX_FIRMWARE_RADEON=y
BR2_PACKAGE_LIBSHA1=y
BR2_PACKAGE_LIBPCIACCESS=y
BR2_PACKAGE_LIBPTHREAD_STUBS=y
BR2_PACKAGE_XUTIL_UTIL_MACROS=y
BR2_PACKAGE_DROPBEAR=y
BR2_PACKAGE_HTOP=y
BR2_TARGET_ROOTFS_CPIO_LZMA=y
BR2_TARGET_ROOTFS_CPIO_UIMAGE=y
BR2_TARGET_ROOTFS_INITRAMFS=y
# BR2_TARGET_ROOTFS_TAR is not set
```
